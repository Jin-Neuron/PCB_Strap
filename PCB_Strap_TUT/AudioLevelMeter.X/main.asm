#include "p16f1823.inc"

; CONFIG1
; __config 0xFC4
 __CONFIG _CONFIG1, _FOSC_INTOSC & _WDTE_OFF & _PWRTE_ON & _MCLRE_ON & _CP_OFF & _CPD_OFF & _BOREN_ON & _CLKOUTEN_OFF & _IESO_OFF & _FCMEN_OFF
 
; CONFIG2
; __config 0x1DFF
 __CONFIG _CONFIG2, _WRT_OFF & _PLLEN_OFF & _STVREN_OFF & _BORV_LO & _LVP_OFF

	CBLOCK  0x70
	   Pins_A	; 0x70
	   Pins_C	; 0x71
	   COUNT	; 0x72
	   Flags	; 0x73
	   count_1	; 0x74
	   count_2	; 0x75
	ENDC
   
MEM1	EQU 0x0C
	ORG 0
	GOTO	START
	ORG 4
START	
	BANKSEL	OSCCON
	MOVLW	B'01111000'  ; Set Clock 
	MOVWF	OSCCON
	
	BANKSEL	PORTA
	CLRF	PORTA	    ; Init PORTA
	BANKSEL PORTC
	CLRF	PORTC	    ; Init PORTC
	
	BANKSEL	LATA
	CLRF	LATA	    ; DataA Latch
	BANKSEL LATC
	CLRF	LATC	    ; DataC Latch
	
	BANKSEL	ANSELA
	MOVLW	B'00000100' ; RA2 as ADC
	MOVWF	ANSELA
	BANKSEL ANSELC
	CLRF	ANSELC	    ; All digital I/O
	
	BANKSEL	TRISA
	MOVLW	B'11001111'
	MOVWF	TRISA
	BANKSEL	TRISC
	MOVLW	B'11000000'
	MOVWF	TRISC
	
	BANKSEL	COUNT
	CLRF	COUNT
	CLRF	Flags
	MOVLW	0xFF
	MOVWF	COUNT
	
		
STEP1	
	BANKSEL	COUNT
	BCF	Flags,0
	BTFSS	COUNT,0
	BSF	Flags,0
	
	MOVF	COUNT,0
	ANDLW	0x03
	MOVWF	Pins_A
	SWAPF	Pins_A,1
	
	MOVF	COUNT,0
	ANDLW	0xFC
	MOVWF	Pins_C
	RRF	Pins_C,1
	RRF	Pins_C,1
	
	MOVF	Pins_A,0
	BANKSEL LATA
	MOVWF	LATA
	
	BANKSEL	Pins_C
	MOVF	Pins_C,0
	BANKSEL LATC
	MOVWF	LATC
	
	CALL	Count64k
	
	BANKSEL	COUNT
	RRF	COUNT,1
	
	MOVLW	0xFF
	BTFSC	Flags,0
	MOVWF	COUNT
	
	GOTO STEP1
	
; ???? 256 x 256 (789 ms)
Count64k
	clrf    count_1
	clrf    count_2
Count64kLoop
	decfsz  count_1,F
	bra     Count64kLoop
	decfsz  count_2,F
	bra     Count64kLoop
	return
	END